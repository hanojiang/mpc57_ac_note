AUTOSAR XML (schema 4-3-0)
package /Port
  module config Port: implementation-config-variant=VARIANT-POST-BUILD, module-description=Port_Impl
    CommonPublishedInformation:
      ArReleaseMajorVersion = 4
      ArReleaseMinorVersion = 3
      ArReleaseRevisionVersion = 1
      ModuleId = 124
      SwMajorVersion = 1
      SwMinorVersion = 0
      SwPatchVersion = 1
      VendorId = 43
    PortConfigSet
      NotUsedPortPin: PortPinDirection=PORT_PIN_IN, PortPinLevelValue=PORT_PIN_LEVEL_LOW, PortPinOde=false, PortPinWpe=false, PortPinWps=false
      3 x PortContainer:
        PortContainer_Can: PortNumberOfPortPins=4
          4 x PortPin, all with PortPinDirectionChangeable=false, PortPinHysteresisControl=false, PortPinInitialMode=PORT_GPIO_MODE, PortPinModeChangeable=false, PortPinOde=false, PortPinSafeMode=false, PortPinSlewRate=HalfDriveWithSlewRate, PortPinWithReadBack=false, PortPinWpe=false, PortPinWps=false:
            can_1: PortPinDirection=PORT_PIN_INOUT, PortPinId=6, PortPinLevelValue=PORT_PIN_LEVEL_LOW, PortPinMode=DSPI_1_dCS1, PortPinPcr=6
            can_2: PortPinDirection=PORT_PIN_IN, PortPinId=7, PortPinLevelValue=PORT_PIN_LEVEL_LOW, PortPinMode=ADC_1_ADC1_S_8, PortPinPcr=7
            can_3: PortPinDirection=PORT_PIN_IN, PortPinId=8, PortPinLevelValue=PORT_PIN_LEVEL_HIGH, PortPinMode=SIUL2_EIRQ3, PortPinPcr=8
            can_4: PortPinDirection=PORT_PIN_IN, PortPinId=9, PortPinLevelValue=PORT_PIN_LEVEL_LOW, PortPinMode=ADC_1_ADC1_S_10, PortPinPcr=9
        PortContainer_Dio: PortNumberOfPortPins=1
          dio_1 (PortPin):
            PortPinDirection = PORT_PIN_OUT
            PortPinDirectionChangeable = false
            PortPinHysteresisControl = false
            PortPinId = 10
            PortPinInitialMode = PORT_GPIO_MODE
            PortPinLevelValue = PORT_PIN_LEVEL_LOW
            PortPinMode = IIC_0_SDA0_OUT
            PortPinModeChangeable = false
            PortPinOde = false
            PortPinPcr = 10
            PortPinSafeMode = false
            PortPinSlewRate = HalfDriveWithSlewRate
            PortPinWithReadBack = false
            PortPinWpe = false
            PortPinWps = false
        PortContainer_Adc: PortNumberOfPortPins=5
          5 x PortPin, all with PortPinDirectionChangeable=false, PortPinHysteresisControl=false, PortPinInitialMode=PORT_GPIO_MODE, PortPinModeChangeable=false, PortPinOde=false, PortPinSafeMode=false, PortPinSlewRate=HalfDriveWithSlewRate, PortPinWithReadBack=false, PortPinWpe=false, PortPinWps=false:
            adc_1: PortPinDirection=PORT_PIN_IN, PortPinId=1, PortPinLevelValue=PORT_PIN_LEVEL_LOW, PortPinMode=EMIOS0_E0UC_1_G_IN, PortPinPcr=1
            adc_2: PortPinDirection=PORT_PIN_INOUT, PortPinId=2, PortPinLevelValue=PORT_PIN_LEVEL_LOW, PortPinMode=GPIO, PortPinPcr=2
            adc_3: PortPinDirection=PORT_PIN_IN, PortPinId=3, PortPinLevelValue=PORT_PIN_LEVEL_LOW, PortPinMode=ADC_1_ADC1_S_0, PortPinPcr=3
            adc_4: PortPinDirection=PORT_PIN_IN, PortPinId=4, PortPinLevelValue=PORT_PIN_LEVEL_LOW, PortPinMode=EMIOS0_E0UC_4_G_IN_OUT, PortPinPcr=4
            adc_5: PortPinDirection=PORT_PIN_IN, PortPinId=5, PortPinLevelValue=PORT_PIN_LEVEL_HIGH, PortPinMode=GPIO, PortPinPcr=5
    PortGeneral:
      PortDevErrorDetect = false
      PortEnableUserModeSupport = false
      PortSet2PinsDirectionApi = false
      PortSetPinDirectionApi = true
      PortSetPinModeApi = true
      PortSetPinModeDoesNotTouchGpioLevel = false
      PortVersionInfoApi = true
